## packages/core/src/analyzer/__fixtures__/embedded-linux/Kconfig
```kconfig
menu "Foo Driver"

config FOO_DRIVER
	tristate "Foo driver support"
	depends on I2C
	select REGMAP_I2C
	default m
	help
	  Foo driver for the Foo peripheral.

config FOO_DEBUG
	bool "Foo driver debug"
	depends on FOO_DRIVER
	default n

endmenu
```

## packages/core/src/analyzer/__fixtures__/embedded-linux/package/Config.in
```kconfig
config BR2_PACKAGE_FOO_SERVICE
	bool "foo-service"
	depends on BR2_TOOLCHAIN_HAS_THREADS
	help
	  Foo service package for Buildroot
```
